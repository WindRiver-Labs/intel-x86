## conf/layer.conf
```bitbake
#
# Copyright (C) 2017 Wind River Systems, Inc.
#

# We have a conf and classes directory, add to BBPATH
BBPATH =. "${LAYERDIR}:"

# We have a packages directory, add to BBFILES
BBFILES += "${LAYERDIR}/recipes-*/*/*.bb \
 	${LAYERDIR}/recipes-*/*/*.bbappend"

BBFILE_COLLECTIONS += "intel-x86"
BBFILE_PATTERN_intel-x86 = "^${LAYERDIR}/"
BBFILE_PRIORITY_intel-x86 = "7"

# This should only be incremented on significant changes that will
# cause compatibility issues with other layers
LAYERVERSION_intel-x86 = "1"

LAYERDEPENDS_intel-x86 = "core wrlinux intel intel-qat"

LAYERSERIES_COMPAT_intel-x86 = "wrl dunfell gatesgarth"

PREMIRRORS_append = " \
	git://.*/.* file://${LAYERDIR}/downloads/ \n \
	svn://.*/.* file://${LAYERDIR}/downloads/ \n \
	ftp://.*/.* file://${LAYERDIR}/downloads/ \n \
	http://.*/.* file://${LAYERDIR}/downloads/ \n \
	https://.*/.* file://${LAYERDIR}/downloads/ \n"
```

## conf/machine/include/qemuboot-intel-x86.inc
```bitbake
QB_MEM ?= "-m 1024"
IMAGE_CLASSES += "qemuboot"

QB_SYSTEM_NAME_intel-x86-64 = "qemu-system-x86_64"
QB_CPU_intel-x86-64 = "-cpu Nehalem"
QB_CPU_KVM_intel-x86-64 = "-cpu kvm64"

QB_AUDIO_DRV = "alsa"
QB_AUDIO_OPT = "-soundhw ac97,es1370"
QB_KERNEL_CMDLINE_APPEND = "oprofile.timer=1"
QB_OPT_APPEND = "-vga std -show-cursor -usb -device usb-tablet"
QB_OPT_APPEND += "-object rng-random,filename=/dev/urandom,id=rng0 -device virtio-rng-pci,rng=rng0"
```

## conf/machine/include/tune-broadwell.inc
```bitbake
DEFAULTTUNE ?= "broadwell-64"

require conf/machine/include/tune-haswell.inc

# Extra tune features
TUNEVALID[broadwell] = "Enable Broadwell specific processor optimizations"
# Handled by SDK.
TUNE_CCARGS .= "${@bb.utils.contains("TUNE_FEATURES", "broadwell", " -march=broadwell -mtune=broadwell -mfpmath=sse -msse4.2 -mavx2", "", d)}"

# Extra tune selections
AVAILTUNES += "broadwell-32 broadwell-64"
TUNE_FEATURES_tune-broadwell-32 = "${TUNE_FEATURES_tune-haswell-ep-32} broadwell"
TUNE_FEATURES_tune-broadwell-64 = "${TUNE_FEATURES_tune-haswell-ep-64} broadwell"
BASE_LIB_tune-broadwell-32 = "lib"
BASE_LIB_tune-broadwell-64 = "lib64"
TUNE_PKGARCH_tune-broadwell-32 = "broadwell-32"
TUNE_PKGARCH_tune-broadwell-64 = "broadwell-64"
PACKAGE_EXTRA_ARCHS_tune-broadwell-32 = "${PACKAGE_EXTRA_ARCHS_tune-haswell-ep-32} broadwell-32"
PACKAGE_EXTRA_ARCHS_tune-broadwell-64 = "${PACKAGE_EXTRA_ARCHS_tune-haswell-ep-64} broadwell-64"
```

## conf/machine/include/tune-haswell.inc
```bitbake
DEFAULTTUNE ?= "haswell-64"

require conf/machine/include/tune-corei7.inc

# Extra tune features
TUNEVALID[haswell] = "Enable Haswell specific processor optimizations"
TUNEVALID[haswell-ep] = "Enable Haswell specific processor optimizations (with working TSX instructions)"
# Handled by SDK.
TUNE_CCARGS .= "${@bb.utils.contains("TUNE_FEATURES", "haswell", " -msse4.2 -mfpmath=sse -march=haswell -mtune=haswell", "", d)}"
EXTRA_OECONF_append_pn-gcc-runtime = " ${@bb.utils.contains("TUNE_FEATURES", "haswell", " --with-cpu=haswell --with-arch=haswell", "", d)}"

# Extra tune selections
AVAILTUNES += "haswell-32 haswell-64"
TUNE_FEATURES_tune-haswell-32 = "${TUNE_FEATURES_tune-x86} haswell"
TUNE_FEATURES_tune-haswell-64 = "${TUNE_FEATURES_tune-x86-64} haswell"
BASE_LIB_tune-haswell-32 = "lib"
BASE_LIB_tune-haswell-64 = "lib64"
TUNE_PKGARCH_tune-haswell-32 = "haswell-32"
TUNE_PKGARCH_tune-haswell-64 = "haswell-64"
PACKAGE_EXTRA_ARCHS_tune-haswell-32 = "${PACKAGE_EXTRA_ARCHS_tune-x86} haswell-32"
PACKAGE_EXTRA_ARCHS_tune-haswell-64 = "${PACKAGE_EXTRA_ARCHS_tune-x86-64}} haswell-64"

AVAILTUNES += "haswell-ep-32 haswell-ep-64"
TUNE_FEATURES_tune-haswell-ep-32 = "${TUNE_FEATURES_tune-haswell-32} haswell-ep"
TUNE_FEATURES_tune-haswell-ep-64 = "${TUNE_FEATURES_tune-haswell-64} haswell-ep"
BASE_LIB_tune-haswell-ep-32 = "lib"
BASE_LIB_tune-haswell-ep-64 = "lib64"
TUNE_PKGARCH_tune-haswell-ep-32 = "haswell-ep-32"
TUNE_PKGARCH_tune-haswell-ep-64 = "haswell-ep-64"
PACKAGE_EXTRA_ARCHS_tune-haswell-ep-32 = "${PACKAGE_EXTRA_ARCHS_tune-haswell-32} haswell-ep-32"
PACKAGE_EXTRA_ARCHS_tune-haswell-ep-64 = "${PACKAGE_EXTRA_ARCHS_tune-haswell-64} haswell-ep-64"
```

## conf/machine/include/tune-skylake-avx512.inc
```bitbake
DEFAULTTUNE ?= "skylake-avx512-64"

require conf/machine/include/tune-skylake.inc

TUNEVALID[skylake-avx512] = "Enable Skylake specific processor optimizations with AVX512 instructions supported"

TUNE_CCARGS .= "${@bb.utils.contains("TUNE_FEATURES", "skylake-avx512", " -msse4.2 -mfpmath=sse -march=skylake-avx512 -mtune=skylake-avx512", "", d)}"
EXTRA_OECONF_append_pn-gcc-runtime = " ${@bb.utils.contains("TUNE_FEATURES", "skylake-avx512", " --with-cpu=skylake-avx512 --with-arch=skylake-avx512", "", d)}"

AVAILTUNES += "skylake-avx512-32 skylake-avx512-64"

TUNE_FEATURES_tune-skylake-avx512-32 = "${TUNE_FEATURES_tune-x86} skylake-avx512 mpx"
TUNE_FEATURES_tune-skylake-avx512-64 = "${TUNE_FEATURES_tune-x86-64} skylake-avx512 mpx"

BASE_LIB_tune-skylake-avx512-32 = "lib"
BASE_LIB_tune-skylake-avx512-64 = "lib64"

TUNE_PKGARCH_tune-skylake-avx512-32 = "skylake-avx512-32"
TUNE_PKGARCH_tune-skylake-avx512-64 = "skylake-avx512-64"

PACKAGE_EXTRA_ARCHS_tune-skylake-avx512-32 = "${PACKAGE_EXTRA_ARCHS_tune-skylake-32} skylake-avx512-32"
PACKAGE_EXTRA_ARCHS_tune-skylake-avx512-64 = "${PACKAGE_EXTRA_ARCHS_tune-skylake-64} skylake-avx512-64"
```

## conf/machine/include/tune-skylake.inc
```bitbake
DEFAULTTUNE ?= "skylake-64"

require conf/machine/include/tune-haswell.inc

# Extra tune features
TUNEVALID[skylake] = "Enable Skylake specific processor optimizations"
# MPX support is not enabled by tunes, because it's a larger-scale
# change than enabling/disabling instructions. Putting this here so
# things could in theory check TUNE_FEATURES for it.
TUNEVALID[mpx] = "Enable support for MPX instructions"
# Handled by SDK.
TUNE_CCARGS .= "${@bb.utils.contains("TUNE_FEATURES", "skylake", " -march=skylake -mtune=skylake -mfpmath=sse", "", d)}"

# Extra tune selections
AVAILTUNES += "skylake-32 skylake-64"
TUNE_FEATURES_tune-skylake-32 = "${TUNE_FEATURES_tune-x86} skylake mpx"
TUNE_FEATURES_tune-skylake-64 = "${TUNE_FEATURES_tune-x86-64} skylake mpx"

BASE_LIB_tune-skylake-32 = "lib"
BASE_LIB_tune-skylake-64 = "lib64"

TUNE_PKGARCH_tune-skylake-32 = "skylake-32"
TUNE_PKGARCH_tune-skylake-64 = "skylake-64"

PACKAGE_EXTRA_ARCHS_tune-skylake-32 = "${PACKAGE_EXTRA_ARCHS_tune-haswell-ep-32} skylake-32"
PACKAGE_EXTRA_ARCHS_tune-skylake-64 = "${PACKAGE_EXTRA_ARCHS_tune-haswell-ep-64} skylake-64"
```

## conf/machine/include/wic-installer.inc
```bitbake
WKS_FILE = "intel-x86-mkefidisk.wks"

# We need rootfs.img as the source of rootfs.
do_add_rootfs_img () {
    install -m 0644 ${ROOTFS} ${IMAGE_ROOTFS}/rootfs.img
}
addtask add_rootfs_img after do_bootimg before do_image_wic

# Remove rootfs.img after packing it into wic image.
# Don't contaminate the original rootfs.
do_delete_rootfs_img () {
    rm -f ${IMAGE_ROOTFS}/rootfs.img
}
addtask delete_rootfs_img after do_image_wic before do_image_complete

IMAGE_BOOT_FILES = "bzImage \
                    ${INITRD_IMAGE_LIVE}-${MACHINE}.${INITRAMFS_FSTYPES};initrd \
                    grub.cfg;EFI/BOOT/grub.cfg"

IMAGE_BOOT_FILES_append_intel-x86-32 = " grub-efi-bootia32.efi;EFI/BOOT/bootia32.efi"
IMAGE_BOOT_FILES_append_intel-x86-64 = " grub-efi-bootx64.efi;EFI/BOOT/bootx64.efi"
```

## conf/machine/intel-haswell-64.conf
```bitbake
#
# Copyright (C) 2018 Wind River Systems, Inc.
#
#@TYPE: Machine
#@NAME: intel-haswell-64
#@DESCRIPTION: Machine configuration for Intel Haswell CPU (64bit)

DEFAULTTUNE = "haswell-64"
require conf/machine/include/tune-haswell.inc
require conf/machine/intel-x86.inc

# multilib support
MULTILIBS ?= "multilib:lib32"
DEFAULTTUNE_virtclass-multilib-lib32 ?= "haswell-32"

KARCH = "x86-64"

KMACHINE_intel-haswell-64 = "intel-x86-64"

# 'qemu-usermode' is not supported by this machine
MACHINE_FEATURES_BACKFILL_CONSIDERED_append = " qemu-usermode"
```

## conf/machine/intel-skylake-64.conf
```bitbake
#
# Copyright (C) 2018 Wind River Systems, Inc.
#
#@TYPE: Machine
#@NAME: intel-skylake-64
#@DESCRIPTION: Machine configuration for Intel Skylake CPU (64bit)

DEFAULTTUNE = "skylake-64"
require conf/machine/include/tune-skylake.inc
require conf/machine/intel-x86.inc

# multilib support
MULTILIBS ?= "multilib:lib32"
DEFAULTTUNE_virtclass-multilib-lib32 ?= "skylake-32"

KARCH = "x86-64"

KMACHINE_intel-skylake-64 = "intel-x86-64"

# 'qemu-usermode' is not supported by this machine
MACHINE_FEATURES_BACKFILL_CONSIDERED_append = " qemu-usermode"
```

## conf/machine/intel-x86-32.conf
```bitbake
#
# Copyright (C) 2017 Wind River Systems, Inc.
#
#@TYPE: Machine
#@NAME: intel-x86-32
#@DESCRIPTION: Machine configuration for running a common intel cpu.

DEFAULTTUNE ?= "corei7-32"
require conf/machine/include/tune-corei7.inc
require conf/machine/intel-x86.inc

KMACHINE_intel-x86-32 = "intel-x86-32"
```

## conf/machine/intel-x86-64.conf
```bitbake
#
# Copyright (C) 2017 Wind River Systems, Inc.
#
#@TYPE: Machine
#@NAME: intel-x86
#@DESCRIPTION: Machine configuration for Intel X86 (64bit) PCs and servers

DEFAULTTUNE ?= "corei7-64"
require conf/machine/include/tune-corei7.inc
require conf/machine/intel-x86.inc

# multilib support
MULTILIBS ?= "multilib:lib32"
DEFAULTTUNE_virtclass-multilib-lib32 ?= "corei7-32"

KARCH = "x86-64"
KMACHINE_intel-x86-64 = "intel-x86-64"
```

## intel-broadwell/conf/layer.conf
```bitbake
#
# Copyright (C) 2017 Wind River Systems, Inc.
#

# We have a conf and classes directory, add to BBPATH
BBPATH =. "${LAYERDIR}:"

# We have a packages directory, add to BBFILES
BBFILES += "${LAYERDIR}/recipes-*/*/*.bb \
	${LAYERDIR}/recipes-*/*/*.bbappend"

BBFILE_COLLECTIONS += "intel-broadwell"
BBFILE_PATTERN_intel-broadwell = ""
BBFILE_PRIORITY_intel-broadwell = "7"

# This should only be incremented on significant changes that will
# cause compatibility issues with other layers
LAYERVERSION_intel-broadwell = "1"

LAYERDEPENDS_intel-broadwell = "intel-x86"

LAYERSERIES_COMPAT_intel-broadwell = "sumo"
```

## intel-broadwell/conf/machine/intel-broadwell-32.conf
```bitbake
#
# Copyright (C) 2017 Wind River Systems, Inc.
#
#@TYPE: Machine
#@NAME: intel-broadwell-32
#@DESCRIPTION: Machine configuration for running a common Intel Broadwell cpu.

DEFAULTTUNE = "broadwell-32"
require conf/machine/include/tune-broadwell.inc
require conf/machine/intel-x86.inc
require intel-broadwell.inc

KMACHINE_intel-broadwell-32 = "intel-x86-32"

MACHINE_FEATURES_BACKFILL_CONSIDERED_append = " qemu-usermode"
```

## intel-broadwell/conf/machine/intel-broadwell-64.conf
```bitbake
#
# Copyright (C) 2017 Wind River Systems, Inc.
#
#@TYPE: Machine
#@NAME: intel-broadwell-64
#@DESCRIPTION: Machine configuration for running a common Intel Boradwell cpu.

DEFAULTTUNE = "broadwell-64"
require conf/machine/include/tune-broadwell.inc
require conf/machine/intel-x86.inc
require intel-broadwell.inc

# multilib support
MULTILIBS ?= "multilib:lib32"
DEFAULTTUNE_virtclass-multilib-lib32 ?= "broadwell-32"

KARCH = "x86-64"

KMACHINE_intel-broadwell-64 = "intel-x86-64"

MACHINE_FEATURES_remove = "qemu-usermode"
```

## intel-haswell/conf/machine/intel-haswell-32.conf
```bitbake
#
# Copyright (C) 2017 Wind River Systems, Inc.
#
#@TYPE: Machine
#@NAME: intel-haswell-32
#@DESCRIPTION: Machine configuration for running a common Intel Haswell cpu.

DEFAULTTUNE = "haswell-32"
require conf/machine/include/tune-haswell.inc
require conf/machine/intel-x86.inc
require intel-haswell.inc

KMACHINE_intel-haswell-32 = "intel-x86-32"

# 'qemu-usermode' is not supported by this machine
MACHINE_FEATURES_BACKFILL_CONSIDERED_append = " qemu-usermode"
```

## intel-haswell/conf/machine/intel-haswell-64.conf
```bitbake
#
# Copyright (C) 2017 Wind River Systems, Inc.
#
#@TYPE: Machine
#@NAME: intel-haswell-64
#@DESCRIPTION: Machine configuration for running a common Intel Haswell cpu.

DEFAULTTUNE = "haswell-64"
require conf/machine/include/tune-haswell.inc
require conf/machine/intel-x86.inc
require intel-haswell.inc

# multilib support
MULTILIBS ?= "multilib:lib32"
DEFAULTTUNE_virtclass-multilib-lib32 ?= "haswell-32"

KARCH = "x86-64"

KMACHINE_intel-haswell-64 = "intel-x86-64"

# 'qemu-usermode' is not supported by this machine
MACHINE_FEATURES_remove = "qemu-usermode"
```

## intel-kabylake/conf/layer.conf
```bitbake
#
# Copyright (C) 2017 Wind River Systems, Inc.
#

# We have a conf and classes directory, add to BBPATH
BBPATH =. "${LAYERDIR}:"

# We have a packages directory, add to BBFILES
BBFILES += "${LAYERDIR}/recipes-*/*/*.bb \
	${LAYERDIR}/recipes-*/*/*.bbappend"

BBFILE_COLLECTIONS += "intel-kabylake"
BBFILE_PATTERN_intel-kabylake = ""
BBFILE_PRIORITY_intel-kabylake = "7"

# This should only be incremented on significant changes that will
# cause compatibility issues with other layers
LAYERVERSION_intel-kabylake = "1"

LAYERDEPENDS_intel-kabylake = "intel-x86"
```

## intel-kabylake/conf/machine/intel-kabylake-32.conf
```bitbake
#
# Copyright (C) 2016 Wind River Systems, Inc.
#
#@TYPE: Machine
#@NAME: intel-kabylake-32
#@DESCRIPTION: Machine configuration for Intel Kabylake cpu.

DEFAULTTUNE = "skylake-32"
require conf/machine/include/tune-skylake.inc
require conf/machine/intel-x86.inc

KMACHINE_intel-kabylake-32 = "intel-x86-32"

# 'qemu-usermode' is not supported by this machine
MACHINE_FEATURES_remove = "qemu-usermode"
```

## intel-kabylake/conf/machine/intel-kabylake-64.conf
```bitbake
#
# Copyright (C) 2017 Wind River Systems, Inc.
#
#@TYPE: Machine
#@NAME: intel-kabylake-64
#@DESCRIPTION: Machine configuration for Intel KabyLake cpu.

DEFAULTTUNE = "skylake-64"
require conf/machine/include/tune-skylake.inc
require conf/machine/intel-x86.inc

# multilib support
MULTILIBS ?= "multilib:lib32"
DEFAULTTUNE_virtclass-multilib-lib32 ?= "skylake-32"

KARCH = "x86-64"

KMACHINE_intel-kabylake-64 = "intel-x86-64"

# 'qemu-usermode' is not supported by this machine
MACHINE_FEATURES_BACKFILL_CONSIDERED_append = " qemu-usermode"
```

## intel-skylake/conf/layer.conf
```bitbake
#
# Copyright (C) 2017 Wind River Systems, Inc.
#

# We have a conf and classes directory, add to BBPATH
BBPATH =. "${LAYERDIR}:"

# We have a packages directory, add to BBFILES
BBFILES += "${LAYERDIR}/recipes-*/*/*.bb \
	${LAYERDIR}/recipes-*/*/*.bbappend"

BBFILE_COLLECTIONS += "intel-skylake"
BBFILE_PATTERN_intel-skylake = ""
BBFILE_PRIORITY_intel-skylake = "7"

# This should only be incremented on significant changes that will
# cause compatibility issues with other layers
LAYERVERSION_intel-skylake = "1"

LAYERDEPENDS_intel-skylake = "intel-x86"

LAYERSERIES_COMPAT_intel-skylake = "sumo"
```

## intel-skylake/conf/machine/intel-skylake-32.conf
```bitbake
#
# Copyright (C) 2017 Wind River Systems, Inc.
#
#@TYPE: Machine
#@NAME: intel-skylake-32
#@DESCRIPTION: Machine configuration for running an Intel Skylake cpu.

DEFAULTTUNE = "skylake-32"
require conf/machine/include/tune-skylake.inc
require conf/machine/intel-x86.inc

KMACHINE_intel-skylake-32 = "intel-x86-32"

# 'qemu-usermode' is not supported by this machine
MACHINE_FEATURES_remove = "qemu-usermode"
```

## intel-skylake/conf/machine/intel-skylake-64.conf
```bitbake
#
# Copyright (C) 2017 Wind River Systems, Inc.
#
#@TYPE: Machine
#@NAME: intel-skylake-64
#@DESCRIPTION: Machine configuration for running an Intel Skylake cpu.

DEFAULTTUNE = "skylake-64"
require conf/machine/include/tune-skylake.inc
require conf/machine/intel-x86.inc

# multilib support
MULTILIBS ?= "multilib:lib32"
DEFAULTTUNE_virtclass-multilib-lib32 ?= "skylake-32"

KARCH = "x86-64"

KMACHINE_intel-skylake-64 = "intel-x86-64"

# 'qemu-usermode' is not supported by this machine
MACHINE_FEATURES_remove = "qemu-usermode"
```
