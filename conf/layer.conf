## intel-skylake/conf/machine/intel-skylake-avx512-32.conf
```bitbake
#
# Copyright (C) 2017 Wind River Systems, Inc.
#
#@TYPE: Machine
#@NAME: intel-skylake-avx512-32
#@DESCRIPTION: Machine configuration for running an intel skylake-avx512 cpu.

DEFAULTTUNE = "skylake-avx512-32"
require conf/machine/include/tune-skylake.inc
require conf/machine/intel-x86.inc

KMACHINE_intel-skylake-avx512-32 = "intel-x86-32"

# 'qemu-usermode' is not supported by this machine
MACHINE_FEATURES_remove = "qemu-usermode"
```
