## intel-skylake/conf/machine/intel-skylake-avx512-64.conf
```bitbake
#
# Copyright (C) 2017 Wind River Systems, Inc.
#
#@TYPE: Machine
#@NAME: intel-skylake-avx512-64
#@DESCRIPTION: Machine configuration for running an intel skylake cpu.

DEFAULTTUNE = "skylake-avx512-64"
require conf/machine/include/tune-skylake.inc
require conf/machine/intel-x86.inc

# multilib support
MULTILIBS ?= "multilib:lib32"
DEFAULTTUNE_virtclass-multilib-lib32 ?= "skylake-avx512-32"

KARCH = "x86-64"

KMACHINE_intel-skylake-avx512-64 = "intel-x86-64"

# 'qemu-usermode' is not supported by this machine
MACHINE_FEATURES_remove = "qemu-usermode"
```

## intel-vmware-guest/conf/layer.conf
```bitbake
#
# Copyright (C) 2017 Wind River Systems, Inc.
#

# We have a conf and classes directory, add to BBPATH
BBPATH =. "${LAYERDIR}:"

# We have a packages directory, add to BBFILES
BBFILES += "${LAYERDIR}/recipes-*/*/*.bb \
	${LAYERDIR}/recipes-*/*/*.bbappend"

BBFILE_COLLECTIONS += "intel-vmware-guest"
BBFILE_PATTERN_intel-vmware-guest = ""
BBFILE_PRIORITY_intel-vmware-guest = "7"

# This should only be incremented on significant changes that will
# cause compatibility issues with other layers
LAYERVERSION_intel-vmware-guest = "1"

LAYERDEPENDS_intel-vmware-guest = "intel-x86"

LAYERSERIES_COMPAT_intel-vmware-guest = "sumo"
```

## intel-vmware-guest/conf/machine/intel-vmware-guest-32.conf
```bitbake
#
# Copyright (C) 2017 Wind River Systems, Inc.
#
#@TYPE: Machine
#@NAME: intel-vmware-guest-32
#@DESCRIPTION: Machine configuration for running a common intel cpu.

DEFAULTTUNE = "corei7-32"
require conf/machine/include/tune-corei7.inc
require conf/machine/intel-x86.inc
require conf/machine/intel-vmware-guest.inc

KMACHINE_intel-vmware-guest-32 = "intel-x86-32"

# 'qemu-usermode' is not supported by this machine
MACHINE_FEATURES_remove = "qemu-usermode"
```

## intel-vmware-guest/conf/machine/intel-vmware-guest-64.conf
```bitbake
#
# Copyright (C) 2017 Wind River Systems, Inc.
#
#@TYPE: Machine
#@NAME: intel-vmware-guest-64
#@DESCRIPTION: Machine configuration for running a common intel cpu.

DEFAULTTUNE = "corei7-64"
require conf/machine/include/tune-corei7.inc
require conf/machine/intel-x86.inc
require conf/machine/intel-vmware-guest.inc

# multilib support
MULTILIBS ?= "multilib:lib32"
DEFAULTTUNE_virtclass-multilib-lib32 ?= "corei7-32"

KARCH = "x86-64"

KMACHINE_intel-vmware-guest-64 = "intel-x86-64"

# 'qemu-usermode' is not supported by this machine
MACHINE_FEATURES_remove = "qemu-usermode"
```

## intel-vmware-guest/conf/machine/intel-vmware-guest.inc
```bitbake
#
# Copyright (C) 2017 Wind River Systems, Inc.
#

KERNEL_FEATURES += "cfg/vmware-guest.scc"

XSERVER += "xf86-input-vmmouse \
	    xf86-video-vmware \
	   "
```

## scripts/lib/wic/canned-wks/mkefidisk-sd.wks
```
# short-description: Create an EFI disk image (SD card)
# long-description: Creates a partitioned EFI disk image that the user
# boards that the user can directly dd to an SD card and boot.

part /boot --source bootimg-efi --sourceparams="loader=grub-efi" --ondisk mmcblk --label msdos --active --align 1024

part / --source rootfs --ondisk mmcblk --fstype=ext4 --label platform --align 1024 --use-uuid

bootloader --ptable gpt --timeout=5 --append="rootfstype=ext4"
```

## wic/intel-x86-mkefidisk.wks
```
# short-description: Create an EFI disk image
# long-description: Creates a partitioned EFI disk image that the user
# can directly dd to boot media.

part /boot --source bootimg-efi --sourceparams="loader=grub-efi" --ondisk sda --label msdos --active --align 1024 --use-uuid

part / --source rootfs --ondisk sda --fstype=ext4 --label platform --align 1024 --use-uuid

bootloader --ptable gpt --timeout=5 --append="rootfstype=ext4 console=ttyS0,115200 console=tty0"
```
